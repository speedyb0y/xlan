## Kconfig
```kconfig
config        XLAN
    tristate "XLAN"
    help
      example

config   XLAN_NET4
    hex "XLAN_NET4"
    default 0xC0000000

config   XLAN_NET6
    hex "XLAN_NET6"
    default 0xFC00000000000000

config   XLAN_HOST
    int "XLAN_HOST"
    default 20

config   XLAN_GW
    int "XLAN_GW"
    default 50

config   XLAN_ANNOUNCE_DELAY
    int "XLAN_ANNOUNCE_DELAY"
    default 3

config   XLAN_ANNOUNCE_INTERVAL
    int "XLAN_ANNOUNCE_INTERVAL"
    default 2

config   XLAN_ANNOUNCE_ROUNDS
    int "XLAN_ANNOUNCE_ROUNDS"
    default 3
```
